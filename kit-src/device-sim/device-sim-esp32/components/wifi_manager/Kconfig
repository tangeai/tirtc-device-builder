## kit-src/device-sim/device-sim-esp32/components/wifi_manager/Kconfig
```kconfig
menu "Wi-Fi provisioning (wifi_manager)"

config WIFI_MANAGER_FALLBACK_DNS_IPV4
    string "Station fallback DNS server"
    default "223.5.5.5"
    help
        Installed into the station's FALLBACK DNS slot after DHCP completes,
        and only when that slot is empty. DHCP-provided main and backup DNS
        servers are never replaced. Board projects may override this value in
        their sdkconfig.defaults. Leave empty to disable the fallback.

endmenu
```

## kit-src/device-sim/templates/esp32-h5-ai/sdkconfig.defaults
```kconfig
CONFIG_IDF_TARGET="esp32s3"
CONFIG_ESP_DEFAULT_CPU_FREQ_MHZ_240=y

# TiRTC SDK 2.5.0 build contract.
CONFIG_FREERTOS_HZ=1000
# CONFIG_FREERTOS_USE_TRACE_FACILITY is not set
# CONFIG_FREERTOS_USE_STATS_FORMATTING_FUNCTIONS is not set
# CONFIG_FREERTOS_GENERATE_RUN_TIME_STATS is not set

CONFIG_ESP_MAIN_TASK_STACK_SIZE=8192
CONFIG_PTHREAD_TASK_STACK_SIZE_DEFAULT=8192

# 模板默认把日志和 starter> 命令行放在原生 USB Serial/JTAG。
CONFIG_ESP_CONSOLE_USB_SERIAL_JTAG=y
CONFIG_ESP_CONSOLE_SECONDARY_NONE=y

# 默认硬件基线：ESP32-S3 N16R8。其他 Flash/PSRAM 规格需要同步调整。
CONFIG_ESPTOOLPY_FLASHSIZE_16MB=y
CONFIG_ESPTOOLPY_FLASHSIZE="16MB"
CONFIG_PARTITION_TABLE_CUSTOM=y
CONFIG_PARTITION_TABLE_CUSTOM_FILENAME="partitions.csv"
CONFIG_PARTITION_TABLE_FILENAME="partitions.csv"

CONFIG_SPIRAM=y
CONFIG_SPIRAM_MODE_OCT=y
CONFIG_SPIRAM_TYPE_AUTO=y
CONFIG_SPIRAM_SPEED_80M=y
CONFIG_SPIRAM_USE_MALLOC=y
CONFIG_SPIRAM_MEMTEST=y
CONFIG_SPIRAM_MALLOC_RESERVE_INTERNAL=131072

# 平台 HTTP/MQTT、TiRTC 和证书校验所需网络/TLS 能力。
CONFIG_LWIP_MAX_SOCKETS=16
CONFIG_MBEDTLS_TLS_SERVER_AND_CLIENT=y
CONFIG_MBEDTLS_SSL_PROTO_TLS1_2=y
CONFIG_MBEDTLS_AES_C=y
CONFIG_MBEDTLS_DES_C=y
CONFIG_MBEDTLS_SHA1_C=y
CONFIG_MBEDTLS_ECP_C=y
CONFIG_MBEDTLS_ECDH_C=y
CONFIG_MBEDTLS_ECDSA_C=y
CONFIG_MBEDTLS_CERTIFICATE_BUNDLE=y
```
